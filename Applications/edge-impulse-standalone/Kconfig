## Applications/edge-impulse-standalone/Kconfig
```kconfig
menu "Edge Impulse standalone project"
comment "Run impulse locally on Eta Compute target"

orsource "Kernel_config"

endmenu
```

## Platform/ECM3532/M3/Kconfig
```kconfig
mainmenu "ETA Build Config"

choice SOC
    prompt "SOC"
    comment "Select Target SOC"
    config ECM3532
	    bool "ECM3532 SOC"
endchoice

config SOC
    string
    default "ecm3532" if ECM3532
if ECM3532
config M3_RAM_START
    hex
    default 0x10000000
config M3_RAM_SIZE
    hex
    default 0x40000
config M3_FLASH_START
    hex "Flash start address"
    default 0x01000000
config M3_FLASH_SIZE
    hex "Flash size"
    default 0x80000
orsource "hw/board/ecm3532/Kconfig"
orsource "hw/csp/ecm3532/Kconfig"
menu "Periphal HAL"
orsource "hw/hal/common/Kconfig"
orsource "hw/hal/ecm3532/Kconfig"
endmenu
orsource "hw/power/ecm3532/Kconfig"
endif
orsource "framework/rpc/Kconfig"
orsource "framework/executor/Kconfig"
orsource "framework/sensor_mgr/Kconfig"
orsource "hw/sensor_drv/Kconfig"
orsource "hw/drivers/Kconfig"

menu "Application Menu"
orsource "appKconfig"
endmenu

choice LINKER_FILE
    prompt "Select Linker File"
    comment "Data and code resides in RAM, FLASH is not used"
    config RAM_ONLY
        bool "RAM Only"
    comment ""

    comment "Data and code resides in RAM, FLASH is not used, \
16K end of RAM is reserved for IPC"
    config RAM_SHM_ONLY
        bool "RAM only and reserved SHM in RAM"
    comment ""

    comment "Execute from FLASH, Data copied to RAM"
    config FLASH
        bool "FLASH and RAM"
    comment ""

    comment "Execute from FLASH and Data copied to RAM, \
16K end of RAM is reserved for IPC"
    config FLASH_SHM
        bool "FLASH and RAM, with reserved SHM in RAM"
    comment ""

    comment "Boot From Flash and relocate to RAM"
    config FLASH_RELOCATE
        bool "FLASH Boot relocate to RAM"
    comment ""

    comment "Boot From Flash and relocate to RAM, \
Reserve SHM for IPC"
    config FLASH_SHM_RELOCATE
        bool "FLASH Boot relocate to RAM with SHM reserved"
    comment ""

endchoice
choice  BIN_FILE_SECTION
        prompt "Bin Array Section"
    config BIN_IN_RODATA
        bool "incbin in text rodata"
    config BIN_IN_BINSECTION
        bool "incbin in flash binSection"
endchoice
config BIN_FILE_SECTION
    string
    default ".rodata" if BIN_IN_RODATA
    default ".binSection" if BIN_IN_BINSECTION

config SHM_LENGTH
    hex "Shared memory Length in Bytes"
    default 0x4000
    depends on (FLASH_SHM_RELOCATE || FLASH_SHM || RAM_SHM_ONLY)

config LINKER_FILE
    string
    default "ram" if RAM_ONLY
    default "ram_shm" if RAM_SHM_ONLY
    default "flash" if FLASH
    default "flash_shm" if FLASH_SHM
    default "flash_relocate_to_ram" if FLASH_RELOCATE
    default "flash_shm_relocate_to_ram" if FLASH_SHM_RELOCATE

menu "General Features"
config CLI
	bool "Enable Command Line Interface"
    depends on (UART_0 || UART_1)
	default y

if ECM3532

config SYSTICK_ON_REF_CLK
    bool
    default y if ECM3532
    default n
config SYSTICK_ON_CPU_CLK
    bool
    default n
endif
config TICK_RATE_HZ
    int "Rtos ticks per sec"
    range 1 500  if SYSTICK_ON_REF_CLK
    range 1 1000
    default 500  if SYSTICK_ON_REF_CLK
    default 1000
if SYSTICK_ON_REF_CLK
config SYSTICK_REF_CLOCK
    int
    default 1024
endif

config HEAP_SIZE
    int "FreeRtos HEAP Size In Bytes"
    default 20000
    comment "Check free heap using FreeHeap command before changing it"

config RTOS_SOFT_TIMER
    bool "RTOS Soft Timer"
    default n

config RTOS_SOFT_TIMER_PEND_CALL
    bool "RTOS Soft Timer Pend Call"
    default n
    depends on RTOS_SOFT_TIMER

config AZURE_IOT_SDK
    bool
    default n
endmenu

orsource "util/packaging/Kconfig"
```

## Platform/ECM3532/M3/framework/rpc/Kconfig
```kconfig
menu "RPC library"

config RPC
    bool "library to enable RPC cross accross processor boundary"
    default n
endmenu
menu "DSP FW Configuations"

config DSP_BACK_DOOR_UART
    bool "enable DSP back door uart"
    depends on RPC  && ECM3531
    default n
config DSP_UART
    bool "enable DSP uart"
    depends on RPC  && ECM3532
    default y

choice DSP_FW
    prompt "Select DSP FW"
    depends on RPC
    config DSP_EXECUTOR
        bool "executor"
    config DSP_HELLO_WORLD
        bool "hello world"
    config DSP_SENSOR
        bool "sensor"
    config DSP_PDM
        bool "pdm fw"
    config DSP_I2C
        bool "i2c"
    config DSP_KERNEL
        bool "kernel"
    config DSP_TIMER
        bool "timer"
    config DSP_MALLOC
        bool "malloc"
endchoice
config DSP_FW
    string
    default "hello_world" if DSP_HELLO_WORLD
    default "executor_test" if DSP_EXECUTOR
    default "sensor_test" if DSP_SENSOR
    default "pdm_test" if DSP_PDM
    default "i2c_test" if DSP_I2C
    default "kernel_test" if DSP_KERNEL
    default "timer_test" if DSP_TIMER
    default "malloc_test" if DSP_MALLOC
endmenu
```

## Platform/ECM3532/M3/hw/drivers/Kconfig
```kconfig
menu "External IO Drivers"
config DISPLAY_NHD0216
	bool "NHD0216 Display Driver"
    depends on EVB_BOARD && I2C_1
    default n
config CAM_HM01B0
	bool "Camera HM01B0 driver"
    default n
    if CAM_HM01B0
    orsource "hm01b0/Kconfig"
    endif
config CAM_HM0360
	bool "Camera HM0360 driver"
    default n
    if CAM_HM0360
    orsource "hm0360/Kconfig"
    endif
config SPI_FLASH
	bool "External SPI Flash"
	depends on (AI_SENSOR_BOARD || AI_VISION_EXTENSION_BOARD) && SPI_1_MASTER
    default y
    if SPI_FLASH
    orsource "spi_flash/Kconfig"
    endif
endmenu
```

## Platform/ECM3532/M3/hw/drivers/hm0360/Kconfig
```kconfig
config STREAMING_MODE
    bool "use streaming mode"
    default n

config HM0360_I2C_INSTANCE
    int "hm0360 I2c Instance"
    default "1"
config HM0360_I2C_ADDRESS
    hex "hm0360 I2C address"
    default 0x24

config IMAGE_COLUMN_COUNT
    int "Image Columns"
    default 256
    range 1 320

config IMAGE_ROW_COUNT
    int "Image Rows"
    default 256
    range 1 320

config HM0360_PCLK_GPIO
    int  "hm0360 PCLK GPIO"
    default 31
config HM0360_VSYNC_GPIO
    int  "hm0360 VSYNC GPIO"
    default 26
config HM0360_HSYNC_GPIO
    int  "hm0360 HSYNC GPIO"
    default 24
config HM0360_D0_PIN
    int  "hm0360 D0 GPIO"
    default 16

choice
    prompt "PCLK Frequency"
    config PCLK_2MHZ
        bool "2MHz"
    config PCLK_1MHZ
        bool "1MHz"
endchoice
```

## Platform/ECM3532/M3/hw/drivers/spi_flash/Kconfig
```kconfig
config SPI_FLASH_CS_PIN
    int  "spi flash chip select GPIO"
    default 31 if AI_SENSOR_BOARD
    default 30 if AI_VISION_EXTENSION_BOARD
config SPI_FLASH_SPI_NUM
    int  "spi flash number"
    default 1
config SPI_FLASH_DEBUG
    bool "Enable / Disable debug logging"
    default 0
choice SPI_FLASH_CHIP
    prompt "Select flash chip"
    config FLASH_MX25R6435F
        bool "MX25R6435F"
endchoice
```

## Platform/ECM3532/M3/hw/power/ecm3532/Kconfig
```kconfig
menu "Power Management Setting"
comment "This enable's DVFS based on system load"

config PM_ENABLE
    bool "Enable Load based DVFS"
    default n
    select HAL_COMMON_TIMER
config PM_WFI_ONLY
    bool "PM LPM as WFI Only"
    depends on PM_ENABLE
    default n
config ENABLE_FRONT_PANEL
    bool "Enable Front Panel Req for Freq Counter"
    default n
    depends on ECM3532

if PM_ENABLE
orsource "src/Kconfig"
endif

config M3_INIT_FREQ
    int "M3 Default Init Frequency in MHz"
    range 20 100
    default 60
    depends on ECM3532

config PM_MON
    bool "CPU load monitor"
    default y
    depends on PM_ENABLE  && ECM3532

endmenu
```
